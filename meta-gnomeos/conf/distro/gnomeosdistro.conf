## meta-gnomeos/conf/distro/gnomeosdistro.conf
```bitbake
DISTRO = "gnomeosdistro"
DISTRO_NAME = "GNOME OS (Poky 6.0+ostree)"
DISTRO_VERSION = "0+snapshot-${DATE}"
SDK_VENDOR = "-gnomesdk"
SDK_VERSION := "${@'${DISTRO_VERSION}'.replace('snapshot-${DATE}','snapshot')}"

MAINTAINER = "Colin Walters <walters@verbum.org>"

TARGET_VENDOR = "-gnomeos"

LOCALCONF_VERSION = "1"

DISTRO_FEATURES_append = " largefile opengl pam"

SDK_NAME = "${DISTRO}-${TCLIBC}-${SDK_ARCH}-${TARGET_ARCH}"
SDKPATH = "/opt/${DISTRO}/${SDK_VERSION}"

QEMU_TARGETS ?= "i386 x86_64"

PREFERRED_PROVIDER_virtual/kernel = "linux-gnome-ostree"

PREMIRRORS ?= "\
bzr://.*/.*   http://autobuilder.yoctoproject.org/sources/ \n \
cvs://.*/.*   http://autobuilder.yoctoproject.org/sources/ \n \
git://.*/.*   http://autobuilder.yoctoproject.org/sources/ \n \
hg://.*/.*    http://autobuilder.yoctoproject.org/sources/ \n \
osc://.*/.*   http://autobuilder.yoctoproject.org/sources/ \n \
p4://.*/.*    http://autobuilder.yoctoproject.org/sources/ \n \
svk://.*/.*   http://autobuilder.yoctoproject.org/sources/ \n \
svn://.*/.*   http://autobuilder.yoctoproject.org/sources/ \n"

MIRRORS =+ "\
ftp://.*/.*      http://autobuilder.yoctoproject.org/sources/ \n \
http://.*/.*     http://autobuilder.yoctoproject.org/sources/ \n \
https://.*/.*    http://autobuilder.yoctoproject.org/sources/ \n"

# The CONNECTIVITY_CHECK_URI's are used to test whether we can succesfully
# fetch from the network (and warn you if not). To disable the test set
# the variable to be empty.
CONNECTIVITY_CHECK_URIS = ""
```

## meta-gnomeos/conf/distro/gnomeostreedistro.conf
```bitbake
DISTRO = "gnomeostreedistro"
DISTRO_NAME = "GNOME Continuous"
DISTRO_VERSION = "0+snapshot-${DATE}"
SDK_VENDOR = "-gnomesdk"
SDK_VERSION := "${@'${DISTRO_VERSION}'.replace('snapshot-${DATE}','snapshot')}"

MAINTAINER = "Colin Walters <walters@verbum.org>"

TARGET_VENDOR = "-gnomeostree"

LOCALCONF_VERSION = "1"

LOCALE_UTF8_ONLY = "1"
DISTRO_FEATURES = "alsa argp bluetooth ext2 irda largefile pcmcia usbgadget usbhost wifi xattr nfs zeroconf pci 3g pam ${DISTRO_FEATURES_LIBC}"

SDK_NAME = "${DISTRO}-${TCLIBC}-${SDK_ARCH}-${TARGET_ARCH}"
SDKPATH = "/opt/${DISTRO}/${SDK_VERSION}"

QEMU_TARGETS ?= "x86_64"

PREFERRED_PROVIDER_virtual/kernel = "linux-yocto"
PREFERRED_VERSION_linux-yocto_qemux86-64 = "3.10%"

PREMIRRORS ?= "\
bzr://.*/.*   http://autobuilder.yoctoproject.org/sources/ \n \
cvs://.*/.*   http://autobuilder.yoctoproject.org/sources/ \n \
git://.*/.*   http://autobuilder.yoctoproject.org/sources/ \n \
hg://.*/.*    http://autobuilder.yoctoproject.org/sources/ \n \
osc://.*/.*   http://autobuilder.yoctoproject.org/sources/ \n \
p4://.*/.*    http://autobuilder.yoctoproject.org/sources/ \n \
svk://.*/.*   http://autobuilder.yoctoproject.org/sources/ \n \
svn://.*/.*   http://autobuilder.yoctoproject.org/sources/ \n"

MIRRORS =+ "\
ftp://.*/.*      http://autobuilder.yoctoproject.org/sources/ \n \
http://.*/.*     http://downloads.yoctoproject.org/mirror/sources/ \n \
https://.*/.*     http://downloads.yoctoproject.org/mirror/sources/ \n \
http://.*/.*     http://autobuilder.yoctoproject.org/sources/ \n \
https://.*/.*    http://autobuilder.yoctoproject.org/sources/ \n"

# The CONNECTIVITY_CHECK_URI's are used to test whether we can succesfully
# fetch from the network (and warn you if not). To disable the test set
# the variable to be empty.
CONNECTIVITY_CHECK_URIS = ""
```

## meta-gnomeos/conf/layer.conf
```bitbake
BBPATH := "${BBPATH}:${LAYERDIR}"

BBFILES := "${BBFILES} ${LAYERDIR}/packages/*/*.bb ${LAYERDIR}/recipies-*/*/*.bb \
	${LAYERDIR}/recipies-*/*/*.bbappend" 

BBFILE_COLLECTIONS += "gnomeos"
BBFILE_PATTERN_gnomeos := "^${LAYERDIR}/"
BBFILE_PRIORITY_gnomeos = "6"
```
